## package/inteno/anyfi/Config.in
```kconfig
config ANYFI_CONTROLLER
	string "Controller IP or FQDN"
	depends PACKAGE_anyfi
	help
	  The default IP address or fully qualified domain name (FQDN)
	  of the Controller that should manage the Anyfi.net software.
```

## package/inteno/bcmkernel/Config.in
```kconfig
menu "Profile and CFE"
depends on PACKAGE_bcmkernel

config BCM_OPEN
       bool
       prompt "Build package for Public SDK"
       default n
       help
		Set this to build an package using a release tarball with the proprietary components removed.

choice
       prompt "Broadcom SDK version"
       default BRCM_SDK_VER_416030
       help
		Version of the Broadcom SDK to use.

config BRCM_SDK_VER_414040
       bool
       prompt "bcmkernel-4.14L.04"

config BRCM_SDK_VER_416021
       bool
       prompt "bcmkernel-4.16L.02A"

config BRCM_SDK_VER_416030
       bool
       prompt "bcmkernel-4.16L.03"

config BRCM_SDK_VER_416040
       bool
       prompt "bcmkernel-4.16L.04"

endchoice

config BCM_KERNEL_PROFILE
       string
       prompt "Broadcom kernel profile"
       default "96368GWV"
       help
		Profile to build the broadcom software with, 96368GWV, 963268GWV, 96362GWV, 96816GWV, 96816OV

config BCM_CFE_PASSWORD
       string
       prompt "Broadcom cfe password"
       default ""

config BCM_CHIP_ID
       string
       prompt "Broadcom chip id"
       default "6368"
       help
		Chip id to build the cfe with, 6328|6362|6368|6816|63268

config BCM_BLNAND
       string
       prompt "Broadcom boot loader nand"
       default "0"
       help
		Set this to 1 to build a boot loader for nand flash

config BCM_ENDPOINT_MODULE
       bool
       prompt "Broadcom endpoint voice FXS support"
       default y
       help
		Set this to include the endpoint module in image

config BCM_USBSOUND_MODULES
       bool
       prompt "Broadcom USB audio support"
       default n
       help
		Set this to include sound support modules in image


config BCM_I2C
       bool
       prompt "Broadcom I2C support"
       default n
       help
		Set this to include the i2c modules in image

config BCM_BLUETOOTH
       bool
       prompt "Broadcom Bluetooth support"
       default n
       help
		Set this to include the Bluetooth modules in image


config SECURE_BOOT_CFE
       prompt "Secure boot CFE"
       bool
	

endmenu
```

## package/inteno/bcmopen/Config.in
```kconfig
menu "Profile and CFE"
depends on PACKAGE_bcmopen

config BCM_KERNEL_PROFILE
       string
       prompt "Broadcom kernel profile"
       default "96368GWV"
       help
		Profile to build the broadcom software with, 96368GWV, 963268GWV, 96362GWV, 96816GWV, 96816OV

config BCM_CHIP_ID
       string
       prompt "Broadcom chip id"
       default "6368"
       help
		Chip id to build the cfe with, 6328|6362|6368|6816|63268

config BCM_BLNAND
       string
       prompt "Broadcom boot loader nand"
       default "0"
       help
		Set this to 1 to build a boot loader for nand flash

config BCM_ENDPOINT_MODULE
       bool
       prompt "Broadcom endpoint voice FXS support"
       default y
       help
		Set this to include the endpoint module in image

config SECURE_BOOT_CFE
       prompt "Secure boot CFE"
       bool
	

endmenu
```

## target/linux/brcm63xx_ref_nand/Config.in
```kconfig
comment "Image naming"

config TARGET_MODEL_NAME
	string
	prompt "Model name + configuration"
	help
		First part of image name

config TARGET_VERSION
	string
	prompt "Model version"
	help
		Second part of image name
	
config TARGET_CUSTOMER
	string
	prompt "Customer ID"
	help
		A Customer id that is added to software file name

config TARGET_IBOARDID
	string
	prompt "Board ID"
	help
		4 letter id code used in the trailer or header to ensure the firmware to be flashed
		is for the correct board. This id is also used in the bcmkernel package to ensure
		that proper data tables are used when applicable. For example:
		D301 -> DG301
		VG50 -> VG50
		D201 -> DG201
```
